## firmware/sdkconfig.defaults
```kconfig
CONFIG_IDF_TARGET="esp32s3"
CONFIG_ESPTOOLPY_FLASHSIZE_8MB=y
CONFIG_SPIRAM=y
CONFIG_SPIRAM_MODE_OCT=y
CONFIG_SPIRAM_SPEED_80M=y
CONFIG_TINYUSB_CDC_ENABLED=y
CONFIG_TINYUSB_CDC_COUNT=1
CONFIG_TINYUSB_CDC_RX_BUFSIZE=1024
CONFIG_TINYUSB_CDC_TX_BUFSIZE=4096
CONFIG_TINYUSB_CDC_EP_BUFSIZE=512
CONFIG_TINYUSB_DESC_MANUFACTURER_STRING="X-Glasses Research"
CONFIG_TINYUSB_DESC_PRODUCT_STRING="X-Glasses S3 Prototype"
CONFIG_TINYUSB_DESC_SERIAL_STRING="UNPROVISIONED"
CONFIG_TINYUSB_DESC_CDC_STRING="XG Binary CDC"
CONFIG_TINYUSB_DEBUG_LEVEL=0
CONFIG_LOG_DEFAULT_LEVEL_WARN=y
CONFIG_ESP_CONSOLE_USB_SERIAL_JTAG=y
```
